## conf/bblayers.conf
```bitbake
# LAYER_CONF_VERSION is increased each time build/conf/bblayers.conf
# changes incompatibly
LCONF_VERSION = "5"

BBPATH = "${TOPDIR}"
BBFILES ?= ""

BSPDIR := "${@os.path.abspath(os.path.dirname(d.getVar('FILE', True)) + '/../..')}"

BBLAYERS ?= " \
  ${BSPDIR}/sources/poky/meta \
  ${BSPDIR}/sources/poky/meta-yocto \
  ${BSPDIR}/sources/poky/meta-yocto-bsp \
  ${BSPDIR}/sources/meta-qt5 \
  ${BSPDIR}/sources/meta-openembedded/meta-oe \
  ${BSPDIR}/sources/meta-openembedded/meta-networking \
  ${BSPDIR}/sources/meta-openembedded/meta-python \
  ${BSPDIR}/sources/meta-openembedded/meta-systemd \
  ${BSPDIR}/sources/meta-openembedded/meta-ruby \
  ${BSPDIR}/sources/meta-bistro \
  ${BSPDIR}/sources/meta-ivi/meta-ivi \
"

BBLAYERS_NON_REMOVABLE ?= " \
  ${BSPDIR}/sources/poky/meta \
  ${BSPDIR}/sources/poky/meta-yocto \
  "
```

## conf/distro/bistro.conf
```bitbake
require bistro.inc

DISTRO_FEATURES += "wayland"

## the "new" wayland-enabled version together with the fitting linux kernel version
### consider to remove PREFERRED_VERSION_linux-boundary as soon as it's 'mainline'
### consider to remove PREFERRED_VERSION_gpu-viv-bin-mx6q as soon as a publicly available version works
PREFERRED_VERSION_gpu-viv-bin-mx6q = "3.10.17-1.0.0-sfp"
```

## conf/distro/bistro.inc
```bitbake
DISTRO = "bistro"
DISTRO_NAME = "Bistro 1.0"
DISTRO_VERSION = "1.5+snapshot-${DATE}"
SDK_VENDOR = "-bistrosdk"
SDK_VERSION := "${@'${DISTRO_VERSION}'.replace('snapshot-${DATE}','snapshot')}"

MAINTAINER = "Erik Botö <erik.boto@pelagicore.com>"

TARGET_VENDOR = "-bistro"

LOCALCONF_VERSION = "1"
LAYER_CONF_VERSION ?= "6"

# Following line is a copy from meta/conf/distro/include/default-distrovars.inc, but without 'x11'  (note: removing the 'x11' from the variable doesn't work due resulting to eglibc build errors)
DISTRO_FEATURES = "alsa argp bluetooth bluez5 ext2 irda largefile pcmcia usbgadget usbhost wifi xattr nfs pci 3g ${DISTRO_FEATURES_LIBC}"

VIRTUAL-RUNTIME_init_manager = "systemd"
VIRTUAL-RUNTIME_initscripts = " "
DISTRO_FEATURES =+ " largefile multiarch systemd ptest"
DISTRO_FEATURES_BACKFILL_CONSIDERED += "sysvinit"

PREFERRED_VERSION_gupnp ?= "0.20.12"
PREFERRED_VERSION_gssdp ?= "0.14.8"
PREFERRED_VERSION_gupnp-av ?= "0.12.4"

SDK_NAME = "${DISTRO}-${TCLIBC}-${SDK_ARCH}-${TARGET_ARCH}"
SDKPATH = "/opt/${DISTRO}/${SDK_VERSION}"

# Override these in bistro based distros to modify DISTRO_EXTRA_R*
BISTRO_DEFAULT_EXTRA_RDEPENDS = "packagegroup-core-boot"
BISTRO_DEFAULT_EXTRA_RRECOMMENDS = "kernel-module-af-packet"

DISTRO_EXTRA_RDEPENDS += " ${BISTRO_DEFAULT_EXTRA_RDEPENDS}"
DISTRO_EXTRA_RRECOMMENDS += " ${BISTRO_DEFAULT_EXTRA_RRECOMMENDS}"

POKYQEMUDEPS = "${@bb.utils.contains("INCOMPATIBLE_LICENSE", "GPLv3", "", "qemu-config",d)}"
DISTRO_EXTRA_RDEPENDS_append_qemuarm = " ${POKYQEMUDEPS}"
DISTRO_EXTRA_RDEPENDS_append_qemumips = " ${POKYQEMUDEPS}"
DISTRO_EXTRA_RDEPENDS_append_qemuppc = " ${POKYQEMUDEPS}"
DISTRO_EXTRA_RDEPENDS_append_qemux86 = " ${POKYQEMUDEPS}"
DISTRO_EXTRA_RDEPENDS_append_qemux86-64 = " ${POKYQEMUDEPS}"

TCLIBCAPPEND = ""

QEMU_TARGETS ?= "arm i386 mips mipsel ppc x86_64 aarch64"
# Other QEMU_TARGETS "mips64 mips64el sh4"

PREMIRRORS ?= "\
bzr://.*/.*   http://downloads.yoctoproject.org/mirror/sources/ \n \
cvs://.*/.*   http://downloads.yoctoproject.org/mirror/sources/ \n \
git://.*/.*   http://downloads.yoctoproject.org/mirror/sources/ \n \
hg://.*/.*    http://downloads.yoctoproject.org/mirror/sources/ \n \
osc://.*/.*   http://downloads.yoctoproject.org/mirror/sources/ \n \
p4://.*/.*    http://downloads.yoctoproject.org/mirror/sources/ \n \
svn://.*/.*   http://downloads.yoctoproject.org/mirror/sources/ \n"

MIRRORS =+ "\
ftp://.*/.*      http://downloads.yoctoproject.org/mirror/sources/ \n \
http://.*/.*     http://downloads.yoctoproject.org/mirror/sources/ \n \
https://.*/.*    http://downloads.yoctoproject.org/mirror/sources/ \n"

# The CONNECTIVITY_CHECK_URI's are used to test whether we can succesfully
# fetch from the network (and warn you if not). To disable the test set
# the variable to be empty.
# Git example url: git://git.yoctoproject.org/yocto-firewall-test;protocol=git;rev=HEAD

PREFERRED_PROVIDER_jpeg = "jpeg"
PREFERRED_PROVIDER_jpeg-native = "jpeg-native"

CONNECTIVITY_CHECK_URIS ?= " \
             https://eula-downloads.yoctoproject.org/index.php \
             http://bugzilla.yoctoproject.org/report.cgi"

SANITY_TESTED_DISTROS ?= " \
            CentOS-6.* \n \
            CentOS-7.* \n \
            CentOS release 5.6 (Final) \n \
            CentOS release 5.7 (Final) \n \
            CentOS release 5.8 (Final) \n \
            CentOS release 6.3 (Final) \n \
            Debian-7.* \n \
            Debian-8.* \n \
            Debian GNU/Linux 6.0.6 (squeeze) \n \
            Debian GNU/Linux 7.0 (wheezy) \n \
            Debian-unstable \n \
            Fedora-21 \n \
            Fedora release 16 (Verne) \n \
            Fedora release 17 (Beefy Miracle) \n \
            Fedora release 18 (Spherical Cow) \n \
            openSUSE 12.2 \n \
            openSUSE-13.2 \n \
            poky-1.7 \n \
            poky-1.8 \n \
            Poky 7.0 (Yocto Project 1.2 Reference Distro) 1.2 \n \
            Poky 8.0 (Yocto Project 1.3 Reference Distro) 1.3 \n \
            Ubuntu 10.04.4 LTS \n \
            Ubuntu 11.10 \n \
            Ubuntu 12.04.1 LTS \n \
            Ubuntu 12.04.2 LTS \n \
            Ubuntu 12.04 LTS \n \
            Ubuntu 12.10 \n \
            Ubuntu-14.04 \n \
            Ubuntu-14.10 \n \
            Ubuntu-15.04 \n \
            Yocto (Built by Poky 7.0) 1.2 \n \
            Yocto (Built by Poky 8.0) 1.2 \n \
	    "

# Default hash policy for distro
BB_SIGNATURE_HANDLER ?= 'OEBasicHash'
#
# OELAYOUT_ABI allows us to notify users when the format of TMPDIR changes in 
# an incompatible way. Such changes should usually be detailed in the commit
# that breaks the format and have been previously discussed on the mailing list 
# with general agreement from the core team.
#
OELAYOUT_ABI = "8"

# add poky sanity bbclass
INHERIT += "poky-sanity"

#WARN_QA = "unsafe-references-in-binaries unsafe-references-in-scripts"
WARN_QA = "textrel pkgvarcheck"
ERROR_QA = "dev-so debug-deps dev-deps debug-files arch la2 pkgconfig la perms useless-rpaths rpaths staticdev ldflags"
```

## conf/distro/gplv2-versions.inc
```bitbake
# Preferred GPLv2 versions of GPLv3 packages.

PREFERRED_VERSION_bash = "3.2.48"
PREFERRED_VERSION_coreutils = "6.9"
PREFERRED_VERSION_gzip = "1.3.12"
PREFERRED_VERSION_readline = "5.2"
PREFERRED_VERSION_rsync = "2.6.9"
PREFERRED_VERSION_gawk = "3.1.5"
PREFERRED_VERSION_bison = "2.3"
PREFERRED_VERSION_gettext = "0.16.1"
PREFERRED_VERSION_gmp = "4.2.1"
```

## conf/layer.conf
```bitbake
# It really depends on order of the layers appearing in BBLAYERS
# variable in toplevel bblayers.conf file, where bitbake will search
# for .inc files and others where bitbake uses BBPATH since it will
# search the directories from first to last as specified in BBPATH
# Therefore if you want a given layer to be considered high priority
# for the .inc and .conf etc. then consider it adding at the beginning
# of BBPATH. For bblayers bitbake will use BBFILES_PRIORITY to resolve
# the recipe contention so the order of directories in BBFILES does 
# not matter.

# We have a conf and classes directory, append to BBPATH
BBPATH .= ":${LAYERDIR}"

# We have a recipes directory, add to BBFILES
BBFILES += "${LAYERDIR}/recipes-*/*/*.bb ${LAYERDIR}/recipes-*/*/*.bbappend"

BBFILE_COLLECTIONS += "bistro-layer"
BBFILE_PATTERN_bistro-layer := "^${LAYERDIR}/"

# Define the priority for recipes (.bb files) from this layer,
# choosing carefully how this layer interacts with all of the
# other layers.

BBFILE_PRIORITY_bistro-layer = "7"

BBFILES_DYNAMIC += " \
    ivi:${LAYERDIR}/dynamic-layers/ivi-layer/*/*/*.bb \
    ivi:${LAYERDIR}/dynamic-layers/ivi-layer/*/*/*.bbappend \
    qt5-layer:${LAYERDIR}/dynamic-layers/qt5-layer/*/*/*.bb \
    qt5-layer:${LAYERDIR}/dynamic-layers/qt5-layer/*/*/*.bbappend \
"

# Export the layer's root directory for use in other recipes
BISTROBASE = '${@os.path.normpath("${LAYERDIR}")}'

LAYERSERIES_COMPAT_bistro-layer = "sumo thud warrior"
```

## conf/machine/qemuarmv7a9.conf
```bitbake
#@TYPE: Machine
#@NAME: qemuarmv7a9
#@DESCRIPTION: Machine configuration for the QEmu ARMv7 cortexa9

require conf/machine/include/qemu.inc
require conf/machine/include/tune-cortexa9.inc

PREFERRED_PROVIDER_virtual/kernel = "linux-yocto"

KERNEL_IMAGETYPE = "zImage"
SERIAL_CONSOLE = "115200 ttyO2"
```
